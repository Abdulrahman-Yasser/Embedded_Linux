## Tasks/5_1_Intro_Yocto/hello/conf/bblayers.conf
```bitbake
BBLAYERS ?= " \
	/home/abdu/Study/Embedded_Linux/Tasks/5_1_Intro_Yocto/hello/mylayer \
"
```

## Tasks/5_2_Editing_image/build_qemu/conf/bblayers.conf
```bitbake
# POKY_BBLAYERS_CONF_VERSION is increased each time build/conf/bblayers.conf
# changes incompatibly
POKY_BBLAYERS_CONF_VERSION = "2"

BBPATH = "${TOPDIR}"
BBFILES ?= ""

BBLAYERS ?= " \
  /home/abdu/Study/Embedded_Linux/git_ignoring/poky/meta \
  /home/abdu/Study/Embedded_Linux/git_ignoring/poky/meta-poky \
  /home/abdu/Study/Embedded_Linux/git_ignoring/poky/meta-yocto-bsp \
  /home/abdu/Study/Embedded_Linux/git_ignoring/poky/meta-my-own \
  "
```

## Tasks/5_2_Editing_image/meta-my-own/conf/distro/hindhall.conf
```bitbake
DISTRO = "hindhall"
DISTRO_NAME = "hindhall (Hind Reference Distro)"
#DISTRO_VERSION = "3.4+snapshot-${METADATA_REVISION}"
DISTRO_VERSION = "4.0.19"
DISTRO_CODENAME = "kirkstone"
SDK_VENDOR = "-hindhallsdk"
SDK_VERSION = "${@d.getVar('DISTRO_VERSION').replace('snapshot-${METADATA_REVISION}', 'snapshot')}"
SDK_VERSION[vardepvalue] = "${SDK_VERSION}"

MAINTAINER = "hindhall <hindhall@lists.yoctoproject.org>"

TARGET_VENDOR = "-hindhall"

LOCALCONF_VERSION = "2"

# Override these in hindhall based distros
HINDHALL_DEFAULT_DISTRO_FEATURES = "largefile opengl ptest multiarch wayland vulkan"
HINDHALL_DEFAULT_EXTRA_RDEPENDS = "packagegroup-core-boot"
HINDHALL_DEFAULT_EXTRA_RRECOMMENDS = "kernel-module-af-packet"

DISTRO_FEATURES ?= "${DISTRO_FEATURES_DEFAULT} ${hindhall_DEFAULT_DISTRO_FEATURES}"

PREFERRED_VERSION_linux-yocto ?= "5.15%"
PREFERRED_VERSION_linux-yocto-rt ?= "5.15%"

SDK_NAME = "${DISTRO}-${TCLIBC}-${SDKMACHINE}-${IMAGE_BASENAME}-${TUNE_PKGARCH}-${MACHINE}"
SDKPATHINSTALL = "/opt/${DISTRO}/${SDK_VERSION}"

DISTRO_EXTRA_RDEPENDS += "${hindhall_DEFAULT_EXTRA_RDEPENDS}"
DISTRO_EXTRA_RRECOMMENDS += "${hindhall_DEFAULT_EXTRA_RRECOMMENDS}"

TCLIBCAPPEND = ""

SANITY_TESTED_DISTROS ?= " \
            hindhall-3.3 \n \
            hindhall-3.4 \n \
            ubuntu-18.04 \n \
            ubuntu-20.04 \n \
            ubuntu-22.04 \n \
            fedora-37 \n \
            debian-11 \n \
            opensuseleap-15.3 \n \
            almalinux-8.8 \n \
            "
# add hindhall sanity bbclass
INHERIT += "hindhall-sanity"

# QA check settings - a little stricter than the OE-Core defaults
# (none currently necessary as we now match OE-Core)
#WARN_TO_ERROR_QA = "X"
#WARN_QA_remove = "${WARN_TO_ERROR_QA}"
#ERROR_QA_append = " ${WARN_TO_ERROR_QA}"

require conf/distro/include/hindhall-world-exclude.inc
require conf/distro/include/no-static-libs.inc
require conf/distro/include/yocto-uninative.inc
require conf/distro/include/security_flags.inc
INHERIT += "uninative"

BB_SIGNATURE_HANDLER ?= "OEEquivHash"
BB_HASHSERVE ??= "auto"
```

## Tasks/5_2_Editing_image/meta-my-own/conf/layer.conf
```bitbake
# We have a conf and classes directory, add to BBPATH
BBPATH .= ":${LAYERDIR}"

# We have recipes-* directories, add to BBFILES
BBFILES += "${LAYERDIR}/recipes-*/*/*.bb \
            ${LAYERDIR}/recipes-*/*/*.bbappend"

BBFILE_COLLECTIONS += "meta-my-own"
BBFILE_PATTERN_meta-my-own = "^${LAYERDIR}/"
BBFILE_PRIORITY_meta-my-own = "6"

LAYERDEPENDS_meta-my-own = "core"
LAYERSERIES_COMPAT_meta-my-own = "kirkstone"
```

## yocto-layers/meta-fresh-new-for-all/conf/distro/fresh-new-distro.conf
```bitbake
require conf/distro/poky.conf

DISTRO = "fresh-new-distro"
DISTRO_NAME = "fresh new distro ny my configurations"
DISTRO_FEATURES:remove = "3g nfc ptest"
```

## yocto-layers/meta-fresh-new-for-all/conf/layer.conf
```bitbake
# We have a conf and classes directory, add to BBPATH
BBPATH .= ":${LAYERDIR}"

# We have recipes-* directories, add to BBFILES
BBFILES += "${LAYERDIR}/recipes-*/*/*.bb \
            ${LAYERDIR}/recipes-*/*/*.bbappend"

BBFILE_COLLECTIONS += "meta-fresh-new-for-all"
BBFILE_PATTERN_meta-fresh-new-for-all = "^${LAYERDIR}/"
BBFILE_PRIORITY_meta-fresh-new-for-all = "6"

LAYERDEPENDS_meta-fresh-new-for-all = "core"
LAYERSERIES_COMPAT_meta-fresh-new-for-all = "kirkstone"
```

## yocto-layers/meta-my-own-rpi/conf/distro/HindHall.conf
```bitbake
require conf/distro/poky.conf

DISTRO_NAME = "HINDHALL (Hind Hall Linux distro for raspberry pi)"

DISTRO_VERSION = "0.1"

INIT_MANAGER ?= "systemd"

PACKAGE_CLASSES ?= "package_rpm"

DISTRO_FEATURES:remove = "3g nfc ptest"
```

## yocto-layers/meta-my-own-rpi/conf/layer.conf
```bitbake
# We have a conf and classes directory, add to BBPATH
BBPATH .= ":${LAYERDIR}"

# We have recipes-* directories, add to BBFILES
BBFILES += "${LAYERDIR}/recipes-*/*/*.bb \
            ${LAYERDIR}/recipes-*/*/*.bbappend"

BBFILE_COLLECTIONS += "meta-my-own-rpi"
BBFILE_PATTERN_meta-my-own-rpi = "^${LAYERDIR}/"
BBFILE_PRIORITY_meta-my-own-rpi = "6"

LAYERDEPENDS_meta-my-own-rpi = "core"
LAYERSERIES_COMPAT_meta-my-own-rpi = "kirkstone"
```

## yocto-layers/meta-my-own/conf/distro/distro-my-own.conf
```bitbake
require conf/distro/poky.conf

DISTRO = "distro-my-own"
DISTRO_NAME = "my-own distro with version ${DISTRO_VERSION}"
DISTRO_FEATURES:remove = "3g nfc ptest"

# All I need to do is to change DISTRO in build/conf/local.conf
```

## yocto-layers/meta-my-own/conf/machine/my-own-machine.conf
```bitbake
MACHINEOVERRIDES = "raspberrypi4:${MACHINE}"
require conf/machine/raspberrypi4.conf

#UART
ENABLE_UART = "1"

#LOGO
DISABLE_RPI_BOOT_LOGO = "1"

#U-boot
# RPI_USE_U_BOOT = "1"
```
